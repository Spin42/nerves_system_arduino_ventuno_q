## Config.in
```kconfig
source "$NERVES_DEFCONFIG_DIR/package/ventuno-q-firmware/Config.in"
source "$NERVES_DEFCONFIG_DIR/package/vk-compute-check/Config.in"
source "$NERVES_DEFCONFIG_DIR/package/fastrpc/Config.in"
source "$NERVES_DEFCONFIG_DIR/package/hexagon-dsp-binaries/Config.in"
source "$NERVES_DEFCONFIG_DIR/package/openocd-stm32/Config.in"
source "$NERVES_DEFCONFIG_DIR/package/arduino-zephyr-loader/Config.in"
```

## package/arduino-zephyr-loader/Config.in
```kconfig
config BR2_PACKAGE_ARDUINO_ZEPHYR_LOADER
	bool "arduino-zephyr-loader"
	help
	  The VENTUNO Q's STM32H5F5 loader from Arduino's Zephyr core
	  (arduino:zephyr), which sketches built with the same core
	  version link against. Installed as
	  /usr/share/ventuno-q/mcu-loader.bin for ventuno-q-mcu.

	  https://github.com/arduino/ArduinoCore-zephyr
```

## package/fastrpc/Config.in
```kconfig
config BR2_PACKAGE_FASTRPC
	bool "fastrpc"
	depends on BR2_aarch64
	select BR2_PACKAGE_LIBYAML
	select BR2_PACKAGE_LIBBSD
	help
	  Qualcomm FastRPC library and daemons, the userspace side of
	  the kernel's FastRPC driver for offloading work to the
	  Hexagon DSPs.

	  https://github.com/qualcomm/fastrpc
```

## package/hexagon-dsp-binaries/Config.in
```kconfig
config BR2_PACKAGE_HEXAGON_DSP_BINARIES
	bool "hexagon-dsp-binaries"
	help
	  The Hexagon DSP shells and libraries the VENTUNO Q's CDSP
	  loads over FastRPC, matching the CDSP firmware from
	  linux-firmware, and the FastRPC configuration that points the
	  board at them.

	  https://github.com/linux-msm/dsp-binaries
```

## package/openocd-stm32/Config.in
```kconfig
config BR2_PACKAGE_OPENOCD_STM32
	bool "openocd-stm32"
	depends on !BR2_PACKAGE_OPENOCD
	depends on BR2_TOOLCHAIN_HEADERS_AT_LEAST_4_8 # libgpiod
	select BR2_PACKAGE_JIMTCL
	select BR2_PACKAGE_LIBGPIOD
	help
	  STMicroelectronics' OpenOCD, which supports the STM32H5 family
	  that mainline OpenOCD lacks. Built with the linuxgpiod adapter
	  to program the VENTUNO Q's STM32H5F5 over the SWD lines wired
	  to SoC GPIOs.

	  https://github.com/STMicroelectronics/OpenOCD
```

## package/ventuno-q-firmware/Config.in
```kconfig
config BR2_PACKAGE_VENTUNO_Q_FIRMWARE
	bool "ventuno-q-firmware"
	help
	  The linux-firmware files the VENTUNO Q's QCS8275 loads: the
	  QUP serial engines, the Adreno 623 GPU and the ADSP, CDSP and
	  GPDSP remote processors.

	  https://gitlab.com/kernel-firmware/linux-firmware
```

## package/vk-compute-check/Config.in
```kconfig
config BR2_PACKAGE_VK_COMPUTE_CHECK
	bool "vk-compute-check"
	depends on BR2_PACKAGE_VULKAN_LOADER
	help
	  Runs one compute shader on the first Vulkan device and checks
	  its output.
```
